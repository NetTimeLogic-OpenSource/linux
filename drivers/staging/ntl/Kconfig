## drivers/staging/ntl/Kconfig
```kconfig
source "drivers/staging/ntl/ntl_phc/Kconfig"
source "drivers/staging/ntl/ntl_macb/Kconfig"
source "drivers/staging/ntl/ntl_sts/Kconfig"
source "drivers/staging/ntl/ntl_sgn/Kconfig"
source "drivers/staging/ntl/ntl_fgn/Kconfig"
source "drivers/staging/ntl/ntl_cts/Kconfig"
```

## drivers/staging/ntl/ntl_cts/Kconfig
```kconfig
config NTL_CTS
	bool "NetTimeLogic CTS devices"
	depends on HAS_IOMEM
	default y
	help
	  If you have a Cross Timestamper IP in the PL.
```

## drivers/staging/ntl/ntl_fgn/Kconfig
```kconfig
#
# NetTimeLogic FGN device configuration
#

config NTL_FGN
	bool "NetTimeLogic FGN devices"
	depends on HAS_IOMEM
	default y
	help
	  If you have a Frequency Generator IP in the PL.
```

## drivers/staging/ntl/ntl_macb/Kconfig
```kconfig
#
# NetTimeLogic MAC/TSU device configuration
#

config NTL_MACB
	tristate "Cadence MACB/GEM support (NTL version)"
	depends on HAS_DMA
	select PHYLIB
	help
	  The Cadence MACB ethernet interface is found on many Atmel AT32 and
	  AT91 parts.  This driver also supports the Cadence GEM (Gigabit
	  Ethernet MAC found in some ARM SoC devices).  Say Y to include
	  support for the MACB/GEM chip.

	  To compile this driver as a module, choose M here: the module
	  will be macb.

config NTL_TSU
	tristate "NetTimeLogic TSU"
	depends on HAS_IOMEM && NTL_MACB
	help
	  The Cadence MACB is configured to get the timestamps from the TSU 
	  in the PL rather than from the MAC.
```

## drivers/staging/ntl/ntl_phc/Kconfig
```kconfig
#
# NetTimeLogic PHC device configuration
#

config NTL_PHC
	bool "NetTimeLogic PHC devices"
	depends on HAS_IOMEM
	default y
	help
	  If you have a Adjustable Counter Clock IP in the PL.
```

## drivers/staging/ntl/ntl_sgn/Kconfig
```kconfig
#
# NetTimeLogic SGN device configuration
#

config NTL_SGN
	bool "NetTimeLogic SGN devices"
	depends on HAS_IOMEM
	default y
	help
	  If you have a Signal Generator IP in the PL.
```
